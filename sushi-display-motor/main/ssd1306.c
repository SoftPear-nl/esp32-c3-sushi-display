#include "ssd1306.h"
#include <string.h>
#include <stdlib.h>
#include "freertos/FreeRTOS.h"
#include "freertos/task.h"

#define SSD1306_CMD  0x00
#define SSD1306_DATA 0x40

static const uint8_t font6x8[96][6] = {
    { 0x00, 0x00, 0x00, 0x00, 0x00, 0x00 }, // 0x20  (space)
    { 0x00, 0x00, 0x5F, 0x00, 0x00, 0x00 }, // 0x21  !
    { 0x00, 0x07, 0x00, 0x07, 0x00, 0x00 }, // 0x22  "
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    { 0x00, 0x00, 0x00, 0x00, 0x00, 0x00 }, // 0x7F  DEL
};

static esp_err_t ssd1306_cmd(i2c_port_t i2c_num, uint8_t cmd) {
    uint8_t buf[2] = {SSD1306_CMD, cmd};
    return i2c_master_write_to_device(i2c_num, SSD1306_I2C_ADDR, buf, 2, 1000/portTICK_PERIOD_MS);
}

esp_err_t ssd1306_init(i2c_port_t i2c_num) {
    vTaskDelay(100 / portTICK_PERIOD_MS);
    ssd1306_cmd(i2c_num, 0xAE); // Display off
    ssd1306_cmd(i2c_num, 0x20); // Set Memory Addressing Mode
    ssd1306_cmd(i2c_num, 0x02); // Page Addressing Mode
    ssd1306_cmd(i2c_num, 0xB0); // Set Page Start Address for Page Addressing Mode
    ssd1306_cmd(i2c_num, 0xC8); // COM Output Scan Direction
    ssd1306_cmd(i2c_num, 0x00); // Low column address
    ssd1306_cmd(i2c_num, 0x10); // High column address
    ssd1306_cmd(i2c_num, 0x40); // Start line address
    ssd1306_cmd(i2c_num, 0x81); // Set contrast control
    ssd1306_cmd(i2c_num, 0xFF);
    ssd1306_cmd(i2c_num, 0xA1); // Segment re-map
    ssd1306_cmd(i2c_num, 0xA6); // Normal display
    ssd1306_cmd(i2c_num, 0xA8); // Set multiplex ratio (40 rows - 1 = 0x27)
    ssd1306_cmd(i2c_num, 0x27);
    ssd1306_cmd(i2c_num, 0xA4); // Output follows RAM content
    ssd1306_cmd(i2c_num, 0xD3); // Set display offset
    ssd1306_cmd(i2c_num, 0x00);
    ssd1306_cmd(i2c_num, 0xD5); // Set display clock divide ratio/oscillator freq
    ssd1306_cmd(i2c_num, 0xF0);
    ssd1306_cmd(i2c_num, 0xD9); // Set pre-charge period
    ssd1306_cmd(i2c_num, 0x22);
    ssd1306_cmd(i2c_num, 0xDA); // Set com pins hardware config (alternative, no remap)
    ssd1306_cmd(i2c_num, 0x12);
    ssd1306_cmd(i2c_num, 0xDB); // Set vcomh
    ssd1306_cmd(i2c_num, 0x20);
    ssd1306_cmd(i2c_num, 0x8D); // Enable charge pump regulator
    ssd1306_cmd(i2c_num, 0x14);
    ssd1306_cmd(i2c_num, 0xAF); // Display ON
    return ESP_OK;
}

void ssd1306_clear(i2c_port_t i2c_num) {
    for (uint8_t page = 0; page < (SSD1306_HEIGHT / 8); page++) {
        uint8_t x = SSD1306_COL_OFFSET;
        ssd1306_cmd(i2c_num, 0xB0 | page);
        ssd1306_cmd(i2c_num, 0x00 | (x & 0x0F));
        ssd1306_cmd(i2c_num, 0x10 | ((x >> 4) & 0x0F));
        uint8_t zeros[SSD1306_WIDTH+1];
        zeros[0] = SSD1306_DATA;
        memset(zeros+1, 0, SSD1306_WIDTH);
        i2c_master_write_to_device(i2c_num, SSD1306_I2C_ADDR, zeros, SSD1306_WIDTH+1, 1000/portTICK_PERIOD_MS);
    }
}

void ssd1306_draw_text(i2c_port_t i2c_num, uint8_t row, uint8_t col, const char *text) {
    // Count characters so we can build one contiguous buffer
    size_t len = strlen(text);
    if (len == 0) return;

    // 1 control byte + up to len*6 data bytes
    size_t buf_size = 1 + len * 6;
    uint8_t *buf = malloc(buf_size);
    if (!buf) return;

    buf[0] = SSD1306_DATA;
    for (size_t i = 0; i < len; i++) {
        uint8_t c = (uint8_t)text[i];
        if (c < 32 || c >= 128) c = 32;   // replace unprintable with space
        memcpy(buf + 1 + i * 6, font6x8[c - 32], 6);
    }

    // Set page and column address (add hardware column offset), then write all pixels in one transaction
    uint8_t x = SSD1306_COL_OFFSET + col * 6;
    ssd1306_cmd(i2c_num, 0xB0 | row);
    ssd1306_cmd(i2c_num, 0x00 | (x & 0x0F));
    ssd1306_cmd(i2c_num, 0x10 | ((x >> 4) & 0x0F));
    i2c_master_write_to_device(i2c_num, SSD1306_I2C_ADDR, buf, buf_size,
                               1000 / portTICK_PERIOD_MS);
    free(buf);
}
